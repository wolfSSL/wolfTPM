## zephyr/Kconfig
```kconfig
menuconfig WOLFTPM
	bool "wolfTPM module support"
	select WOLFSSL

if WOLFTPM
config WOLFTPM_DEBUG
	bool "wolfTPM debug activation"
	help
	  Enable debugging activation for wolfTPM.

config WOLFTPM_I2C
	bool "wolfTPM I2C support"
	help
		Enables the I2C HAL and Advanced IO

config WOLFTPM_SPI
	bool "wolfTPM SPI support"
	help
		Enables the SPI HAL (default)

config ZEPHYR_WOLFTPM_MODULE
	bool
	depends on WOLFTPM
endif

# Add relevant macros for tpm
```

## zephyr/samples/wolftpm_wrap_caps/sample.yaml
```yaml
sample:
  description: wolfTPM wrap caps
  name: wolfTPM wrap caps
common:
  harness: console
  harness_config:
    type: one_line
    regex:
      - "wolfTPM caps read successfully"
tests:
  sample.lib.wolftpm_wrap_caps:
    timeout: 200
    platform_allow: qemu_x86
    integration_platforms:
      - qemu_x86
```

## zephyr/samples/wolftpm_wrap_test/sample.yaml
```yaml
sample:
  description: wolfTPM wrap test
  name: wolfTPM wrap test
common:
  harness: console
  harness_config:
    type: one_line
    regex:
      - "wolfTPM wrapper test completed successfully"
tests:
  sample.lib.wolftpm_wrap_test:
    timeout: 200
    platform_allow: qemu_x86
    integration_platforms:
      - qemu_x86
```
